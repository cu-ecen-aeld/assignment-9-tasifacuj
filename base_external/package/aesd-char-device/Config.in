## base_external/package/aesd-char-device/Config.in
```kconfig
config BR2_PACKAGE_AESD_CHAR_DEVICE
	bool "aesd-char-device"
	help
	  Includes aesd-char-device driver.
```

## base_external/package/ldd/Config.in
```kconfig
config BR2_PACKAGE_LDD
	bool "ldd"
	help
	  Includes misc-module, scull drivers from aesd.
```
